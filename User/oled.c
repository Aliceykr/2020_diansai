#include "oled.h"
#include "i2c.h"
#include <string.h>
#include <stdarg.h>
#include <stdio.h>

/* 显存：每字节 8 个纵向像素，OLED_WIDTH 列 x OLED_PAGES 页 */
static uint8_t OLED_Buffer[OLED_WIDTH * OLED_PAGES];

/* 写一条命令字节（控制字 0x00 表示后续为命令） */
static void OLED_WriteCmd(uint8_t cmd)
{
    uint8_t data[] = {0x00, cmd};
    HAL_I2C_Master_Transmit(&hi2c2, OLED_ADDR << 1, data, 2, HAL_MAX_DELAY);
}

/* 连续写一块数据字节（首字节需为 0x40 数据控制字，由调用方准备） */
static void OLED_WriteDataBlock(const uint8_t *data, uint16_t len)
{
    HAL_I2C_Master_Transmit(&hi2c2, OLED_ADDR << 1, (uint8_t *)data, len, HAL_MAX_DELAY);
}

/* 初始化 SSD1306：上电配置寄存器、清屏后开显示 */
void OLED_Init(void)
{
    HAL_Delay(100);

    OLED_WriteCmd(0xAE);
    OLED_WriteCmd(0x20);
    OLED_WriteCmd(0x00);
    OLED_WriteCmd(0xB0);
    OLED_WriteCmd(0xC8);
    OLED_WriteCmd(0x00);
    OLED_WriteCmd(0x10);
    OLED_WriteCmd(0x40);
    OLED_WriteCmd(0x81);
    OLED_WriteCmd(0xFF);
    OLED_WriteCmd(0xA1);
    OLED_WriteCmd(0xA6);
    OLED_WriteCmd(0xA8);
    OLED_WriteCmd(0x3F);
    OLED_WriteCmd(0xA4);
    OLED_WriteCmd(0xD3);
    OLED_WriteCmd(0x00);
    OLED_WriteCmd(0xD5);
    OLED_WriteCmd(0xF0);
    OLED_WriteCmd(0xD9);
    OLED_WriteCmd(0x22);
    OLED_WriteCmd(0xDA);
    OLED_WriteCmd(0x12);
    OLED_WriteCmd(0xDB);
    OLED_WriteCmd(0x20);
    OLED_WriteCmd(0x8D);
    OLED_WriteCmd(0x14);

    OLED_WriteCmd(0xAF);   /* 先开显示，后续 Clear 的自动刷屏才能生效 */
    OLED_Clear();          /* 内部自动刷屏，上电即显示空白画面 */
}

/* 逐页把显存刷到屏幕（页寻址模式） */
void OLED_Display(void)
{
    uint8_t tx_buf[OLED_WIDTH + 1];
    tx_buf[0] = 0x40;

    for (uint8_t page = 0; page < OLED_PAGES; page++)
    {
        OLED_WriteCmd(0xB0 + page);
        OLED_WriteCmd(0x00);
        OLED_WriteCmd(0x10);

        memcpy(tx_buf + 1, OLED_Buffer + page * OLED_WIDTH, OLED_WIDTH);
        HAL_I2C_Master_Transmit(&hi2c2, OLED_ADDR << 1, tx_buf, sizeof(tx_buf), HAL_MAX_DELAY);
    }
}

/* 整屏显存一次性刷出（单次 I2C 事务，~9ms @800kHz） */
void OLED_DisplayFast(void)
{
    OLED_WriteCmd(0x20);
    OLED_WriteCmd(0x00);
    OLED_WriteCmd(0x21);
    OLED_WriteCmd(0x00);
    OLED_WriteCmd(0x7F);
    OLED_WriteCmd(0x22);
    OLED_WriteCmd(0x00);
    OLED_WriteCmd(0x07);

    uint8_t tx_buf[OLED_WIDTH * OLED_PAGES + 1];
    tx_buf[0] = 0x40;
    memcpy(tx_buf + 1, OLED_Buffer, sizeof(OLED_Buffer));
    HAL_I2C_Master_Transmit(&hi2c2, OLED_ADDR << 1, tx_buf, sizeof(tx_buf), HAL_MAX_DELAY);
}

/* 清空显存（全灭），自动刷屏 */
void OLED_Clear(void)
{
    for (uint16_t i = 0; i < sizeof(OLED_Buffer); i++)
        OLED_Buffer[i] = 0x00;
    OLED_DisplayFast();
}

/* 显存全亮，自动刷屏 */
void OLED_Fill(void)
{
    for (uint16_t i = 0; i < sizeof(OLED_Buffer); i++)
        OLED_Buffer[i] = 0xFF;
    OLED_DisplayFast();
}

/* 在 (x,y) 设置/清除单个像素，color=1 点亮、0 熄灭；越界忽略 */
void OLED_DrawPixel(uint8_t x, uint8_t y, uint8_t color)
{
    if (x >= OLED_WIDTH || y >= OLED_HEIGHT)
        return;

    if (color)
        OLED_Buffer[x + (y / 8) * OLED_WIDTH] |= (1 << (y % 8));
    else
        OLED_Buffer[x + (y / 8) * OLED_WIDTH] &= ~(1 << (y % 8));
}

/* 6x8 ASCII 字库，从空格 ' ' 起，每字符 6 列、每列 8 个纵向像素 */
static const uint8_t Font6x8[][6] = {
    {0x00,0x00,0x00,0x00,0x00,0x00},
    {0x00,0x00,0x5F,0x00,0x00,0x00},
    {0x00,0x07,0x00,0x07,0x00,0x00},
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    {0x08,0x1C,0x2A,0x08,0x08,0x00},
};

/* 在 (x,y) 写一个 6x8 字符（仅写显存，非可见 ASCII 用空格代替） */
void OLED_ShowChar(uint8_t x, uint8_t y, char ch)
{
    if (ch < ' ' || ch > '~')
        ch = ' ';
    ch -= ' ';

    for (uint8_t i = 0; i < 6; i++)
    {
        uint8_t line = Font6x8[ch][i];
        for (uint8_t j = 0; j < 8; j++)
        {
            if (line & (1 << j))
                OLED_DrawPixel(x + i, y + j, 1);
            else
                OLED_DrawPixel(x + i, y + j, 0);
        }
    }
}
/* 在 (x,y) 写字符串，每字符宽 6 像素，到右边界自动折到下一行 */
void OLED_ShowString(uint8_t x, uint8_t y, const char *str)
{
    while (*str)
    {
        OLED_ShowChar(x, y, *str++);
        x += 6;
        if (x + 6 > OLED_WIDTH)
        {
            x = 0;
            y += 8;
        }
    }
}


/* 在 (x,y) 格式化输出（用法同 printf） */
void OLED_Printf(uint8_t x, uint8_t y, const char *fmt, ...)
{
    char buf[32];
    va_list ap;

    va_start(ap, fmt);
    vsnprintf(buf, sizeof(buf), fmt, ap);
    va_end(ap);

    OLED_ShowString(x, y, buf);
}
